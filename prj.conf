## CMakeLists.txt
```
cmake_minimum_required(VERSION 3.20.0)
find_package(Zephyr REQUIRED HINTS $ENV{ZEPHYR_BASE})
project(zephyr_uart_framing_node)

target_sources(app PRIVATE
    src/main.c
    src/framer.c
)

target_include_directories(app PRIVATE src)
```

## Kconfig
```
mainmenu "Zephyr UART Framing Node"

module = FRAMER
module-str = framer
source "subsys/logging/Kconfig.template.log_config"

source "Kconfig.zephyr"
```

## west.yml
```
manifest:
  self:
    path: zephyr-uart-framing-node

  remotes:
    - name: zephyrproject-rtos
      url-base: https://github.com/zephyrproject-rtos

  projects:
    - name: zephyr
      remote: zephyrproject-rtos
      revision: v3.7.0
      import: true
```

## prj.conf
```kconfig
# Enable logging so LOG_INF() calls print
CONFIG_LOG=y
CONFIG_LOG_DEFAULT_LEVEL=3
CONFIG_LOG_MODE_IMMEDIATE=y
CONFIG_LOG_PRINTK=y

# Larger main stack for our demo
CONFIG_MAIN_STACK_SIZE=4096

# Enable ring buffer subsystem (used by future UART driver integration)
CONFIG_RING_BUFFER=y

# Framer module log level (0=off .. 4=debug)
CONFIG_FRAMER_LOG_LEVEL=3

# Thread naming helps debug output
CONFIG_THREAD_NAME=y
CONFIG_THREAD_MONITOR=y
```

## src/main.c
```c
/*
 * Copyright (c) 2026 Devyansh Agarwal
 * SPDX-License-Identifier: Apache-2.0
 *
 * Demo application: a producer thread synthesizes framed byte streams
 * (well-formed, then a corrupted frame, then a well-formed one after
 * garbage), a "RX" thread feeds bytes into the framer one at a time
 * (modelling an ISR pushing bytes as they arrive), and a consumer
 * thread pulls decoded frames off the queue and logs them.
 *
 * On real hardware, the producer thread is replaced by a UART ISR
 * calling framer_feed_byte() on each received byte. The framer API
 * does not change.
 */

#include "framer.h"

#include <zephyr/kernel.h>
#include <zephyr/logging/log.h>
#include <string.h>

LOG_MODULE_REGISTER(main, LOG_LEVEL_INF);

#define STACK_SIZE 2048
#define PROD_PRIO   5
#define CONS_PRIO   4

static K_THREAD_STACK_DEFINE(prod_stack, STACK_SIZE);
static K_THREAD_STACK_DEFINE(cons_stack, STACK_SIZE);
static struct k_thread prod_thread_data;
static struct k_thread cons_thread_data;

/* Byte queue that models the ISR-to-thread hand-off. In real firmware
 * the UART ISR would push into this and the RX task would drain it. */
K_MSGQ_DEFINE(rx_bytes, sizeof(uint8_t), 512, 1);

/*
 * Build a framed packet into `out` and return its length.
 *   [SOF][LEN][PAYLOAD][CRC16_HI][CRC16_LO]
 */
static size_t build_frame(const uint8_t *payload, uint8_t len, uint8_t *out)
{
    uint8_t crc_input[1 + FRAMER_MAX_PAYLOAD];
    crc_input[0] = len;
    memcpy(&crc_input[1], payload, len);
    uint16_t crc = framer_crc16_ccitt(crc_input, 1U + len);

    size_t i = 0;
    out[i++] = FRAMER_SOF;
    out[i++] = len;
    memcpy(&out[i], payload, len);
    i += len;
    out[i++] = (uint8_t)(crc >> 8);
    out[i++] = (uint8_t)(crc & 0xFF);
    return i;
}

static void push_bytes(const uint8_t *bytes, size_t n)
{
    for (size_t i = 0; i < n; i++) {
        (void)k_msgq_put(&rx_bytes, &bytes[i], K_FOREVER);
    }
}

static void producer_thread(void *a, void *b, void *c)
{
    ARG_UNUSED(a); ARG_UNUSED(b); ARG_UNUSED(c);

    uint8_t buf[FRAMER_MAX_PAYLOAD + 8];

    /* Frame A: well-formed */
    const uint8_t payload_a[] = { 0xDE, 0xAD, 0xBE, 0xEF };
    size_t na = build_frame(payload_a, sizeof(payload_a), buf);
    push_bytes(buf, na);
    k_sleep(K_MSEC(50));

    /* Frame B: garbage prefix + well-formed frame (resync test) */
    const uint8_t garbage[] = { 0x00, 0x11, 0x22, 0x33 };
    push_bytes(garbage, sizeof(garbage));
    const uint8_t payload_b[] = { 'H', 'E', 'L', 'L', 'O' };
    size_t nb = build_frame(payload_b, sizeof(payload_b), buf);
    push_bytes(buf, nb);
    k_sleep(K_MSEC(50));

    /* Frame C: corrupt CRC on purpose */
    const uint8_t payload_c[] = { 0x01, 0x02, 0x03 };
    size_t nc = build_frame(payload_c, sizeof(payload_c), buf);
    buf[nc - 1] ^= 0xFF; /* flip CRC LSB */
    push_bytes(buf, nc);
    k_sleep(K_MSEC(50));

    /* Frame D: well-formed, proves recovery after CRC error */
    const uint8_t payload_d[] = { 'W', 'O', 'R', 'L', 'D', '!' };
    size_t nd = build_frame(payload_d, sizeof(payload_d), buf);
    push_bytes(buf, nd);
}

/* This thread models the RX-side dispatcher that would run in
 * a real UART ISR: pull one byte, hand it to the framer, repeat. */
static void consumer_thread(void *a, void *b, void *c)
{
    ARG_UNUSED(a); ARG_UNUSED(b); ARG_UNUSED(c);

    /* Byte-shovel loop */
    k_tid_t self = k_current_get();
    ARG_UNUSED(self);

    /* Two sub-loops: byte feeder + frame collector, cooperatively via yielding */
    while (1) {
        uint8_t byte;
        int rc = k_msgq_get(&rx_bytes, &byte, K_MSEC(10));
        if (rc == 0) {
            framer_feed_byte(byte);
        }

        struct framer_frame f;
        while (framer_get_frame(&f, K_NO_WAIT) == 0) {
            LOG_INF("RX frame len=%u first=0x%02x last=0x%02x",
                    f.len, f.data[0], f.data[f.len - 1]);
        }

        struct framer_stats st;
        framer_get_stats(&st);
        static uint32_t last_ok;
        if (st.frames_ok != last_ok) {
            last_ok = st.frames_ok;
            LOG_INF("stats: ok=%u crc_err=%u resyncs=%u dropped=%u",
                    st.frames_ok, st.frames_crc_err,
                    st.resyncs, st.bytes_dropped);
        }
    }
}

int main(void)
{
    LOG_INF("zephyr-uart-framing-node starting");
    framer_init();

    k_thread_create(&cons_thread_data, cons_stack, STACK_SIZE,
                    consumer_thread, NULL, NULL, NULL,
                    CONS_PRIO, 0, K_NO_WAIT);
    k_thread_name_set(&cons_thread_data, "framer_consumer");

    k_thread_create(&prod_thread_data, prod_stack, STACK_SIZE,
                    producer_thread, NULL, NULL, NULL,
                    PROD_PRIO, 0, K_MSEC(100));
    k_thread_name_set(&prod_thread_data, "demo_producer");

    return 0;
}
```

## src/framer.c
```c
/*
 * Copyright (c) 2026 Devyansh Agarwal
 * SPDX-License-Identifier: Apache-2.0
 *
 * Byte-at-a-time framing state machine with CRC-16/CCITT-FALSE validation
 * and automatic resync on corruption. Zephyr port of ringbuf-parser.
 */

#include "framer.h"

#include <zephyr/kernel.h>
#include <zephyr/logging/log.h>
#include <string.h>

LOG_MODULE_REGISTER(framer, CONFIG_FRAMER_LOG_LEVEL);

/* Queue of decoded frames handed off to the consumer thread. */
K_MSGQ_DEFINE(framer_msgq, sizeof(struct framer_frame), 4, 4);

enum parser_state {
    STATE_WAIT_SOF,
    STATE_READ_LEN,
    STATE_READ_PAYLOAD,
    STATE_READ_CRC_HI,
    STATE_READ_CRC_LO,
};

static struct {
    enum parser_state state;
    uint8_t  len;
    uint8_t  payload_idx;
    uint8_t  payload[FRAMER_MAX_PAYLOAD];
    uint16_t crc_recv;
    struct framer_stats stats;
} parser;

/* CRC-16/CCITT-FALSE (poly=0x1021, init=0xFFFF, no reflection, no xor-out). */
uint16_t framer_crc16_ccitt(const uint8_t *data, size_t len)
{
    uint16_t crc = 0xFFFF;

    for (size_t i = 0; i < len; i++) {
        crc ^= (uint16_t)data[i] << 8;
        for (int bit = 0; bit < 8; bit++) {
            if (crc & 0x8000) {
                crc = (crc << 1) ^ 0x1021;
            } else {
                crc <<= 1;
            }
        }
    }
    return crc;
}

static void reset_to_wait_sof(bool count_as_resync)
{
    if (count_as_resync && parser.state != STATE_WAIT_SOF) {
        parser.stats.resyncs++;
    }
    parser.state = STATE_WAIT_SOF;
    parser.len = 0;
    parser.payload_idx = 0;
    parser.crc_recv = 0;
}

void framer_init(void)
{
    memset(&parser, 0, sizeof(parser));
    parser.state = STATE_WAIT_SOF;
    k_msgq_purge(&framer_msgq);
}

int framer_feed_byte(uint8_t b)
{
    switch (parser.state) {
    case STATE_WAIT_SOF:
        if (b == FRAMER_SOF) {
            parser.state = STATE_READ_LEN;
        } else {
            parser.stats.bytes_dropped++;
        }
        break;

    case STATE_READ_LEN:
        parser.len = b;
        parser.payload_idx = 0;
        if (parser.len == 0) {
            /* zero-length payload: skip straight to CRC */
            parser.state = STATE_READ_CRC_HI;
        } else {
            parser.state = STATE_READ_PAYLOAD;
        }
        break;

    case STATE_READ_PAYLOAD:
        parser.payload[parser.payload_idx++] = b;
        if (parser.payload_idx >= parser.len) {
            parser.state = STATE_READ_CRC_HI;
        }
        break;

    case STATE_READ_CRC_HI:
        parser.crc_recv = ((uint16_t)b) << 8;
        parser.state = STATE_READ_CRC_LO;
        break;

    case STATE_READ_CRC_LO: {
        parser.crc_recv |= b;

        /* Build the buffer that was CRC'd: LEN || PAYLOAD */
        uint8_t crc_input[1 + FRAMER_MAX_PAYLOAD];
        crc_input[0] = parser.len;
        memcpy(&crc_input[1], parser.payload, parser.len);
        uint16_t crc_calc = framer_crc16_ccitt(crc_input, 1U + parser.len);

        if (crc_calc == parser.crc_recv) {
            struct framer_frame f = {
                .len = parser.len,
            };
            memcpy(f.data, parser.payload, parser.len);

            int rc = k_msgq_put(&framer_msgq, &f, K_NO_WAIT);
            if (rc == 0) {
                parser.stats.frames_ok++;
            } else {
                /* consumer isn't draining fast enough; drop and count */
                parser.stats.bytes_dropped += parser.len;
                LOG_WRN("msgq full; dropping frame len=%u", parser.len);
            }
        } else {
            parser.stats.frames_crc_err++;
            LOG_DBG("CRC mismatch: got 0x%04x expected 0x%04x",
                    parser.crc_recv, crc_calc);
        }

        reset_to_wait_sof(false);
        break;
    }

    default:
        reset_to_wait_sof(true);
        return -EINVAL;
    }

    return 0;
}

int framer_get_frame(struct framer_frame *out, k_timeout_t timeout)
{
    if (out == NULL) {
        return -EINVAL;
    }
    return k_msgq_get(&framer_msgq, out, timeout);
}

void framer_get_stats(struct framer_stats *out)
{
    if (out == NULL) {
        return;
    }
    unsigned int key = irq_lock();
    *out = parser.stats;
    irq_unlock(key);
}
```

## src/framer.h
```c
/*
 * Copyright (c) 2026 Devyansh Agarwal
 * SPDX-License-Identifier: Apache-2.0
 *
 * Byte-stream framing parser for embedded RX paths.
 *
 * Frame format:
 *   [SOF=0x7E] [LEN] [PAYLOAD ...LEN bytes...] [CRC16_HI] [CRC16_LO]
 *
 * CRC is CRC-16/CCITT-FALSE (poly 0x1021, init 0xFFFF, no reflection, no xor-out)
 * computed over LEN and PAYLOAD.
 *
 * Designed for an ISR-to-thread hand-off pattern: bytes arrive in an
 * interrupt, are pushed into an internal ring buffer, and a consumer
 * thread pulls decoded frames out via framer_get_frame().
 */

#ifndef FRAMER_H_
#define FRAMER_H_

#include <stddef.h>
#include <stdint.h>
#include <zephyr/kernel.h>
#include <zephyr/sys/ring_buffer.h>

#define FRAMER_SOF          0x7E
#define FRAMER_MAX_PAYLOAD  255U

/* Diagnostic counters exposed for shell / test inspection. */
struct framer_stats {
    uint32_t frames_ok;
    uint32_t frames_crc_err;
    uint32_t bytes_dropped;   /* bytes discarded during resync */
    uint32_t resyncs;         /* number of times parser resynced on garbage */
};

/* One decoded frame handed off to the consumer thread. */
struct framer_frame {
    uint8_t len;
    uint8_t data[FRAMER_MAX_PAYLOAD];
};

/*
 * framer_init - reset parser state and clear stats.
 * Call once before feeding bytes.
 */
void framer_init(void);

/*
 * framer_feed_byte - push one byte into the parser.
 *
 * On a completed valid frame, the frame is pushed onto the internal
 * message queue and can be retrieved with framer_get_frame().
 *
 * Safe to call from thread context. If called from an ISR, ensure the
 * downstream message queue submit is ISR-safe (k_msgq_put is).
 *
 * Returns 0 on success, negative errno on internal error.
 */
int framer_feed_byte(uint8_t b);

/*
 * framer_get_frame - block up to `timeout` for the next decoded frame.
 *
 * Returns 0 on success and fills *out; -EAGAIN on timeout.
 */
int framer_get_frame(struct framer_frame *out, k_timeout_t timeout);

/*
 * framer_get_stats - snapshot diagnostic counters.
 */
void framer_get_stats(struct framer_stats *out);

/*
 * framer_crc16_ccitt - exposed for producer-side frame construction and tests.
 */
uint16_t framer_crc16_ccitt(const uint8_t *data, size_t len);

#endif /* FRAMER_H_ */
```
